## meta-agl-demo/conf/layer.conf
```bitbake
# We have a conf and classes directory, add to BBPATH
BBPATH =. "${LAYERDIR}:"

# We have recipes-* directories, add to BBFILES
BBFILES += "${LAYERDIR}/recipes-*/*/*.bb \
            ${LAYERDIR}/recipes-*/*/*.bbappend"

BBFILE_COLLECTIONS += "agldemo"
BBFILE_PATTERN_agldemo = "^${LAYERDIR}/"
BBFILE_PRIORITY_agldemo = "70"

BBFILES_DYNAMIC += " \
    meta-tensorflow:${LAYERDIR}/dynamic-layers/meta-tensorflow/*/*/*.bbappend \
    openembedded-layer:${LAYERDIR}/dynamic-layers/meta-oe/*/*/*.bbappend \
"

LICENSE_PATH += "${LAYERDIR}/licenses"

LAYERSERIES_COMPAT_agldemo = "wrynose"

LAYERDEPENDS_agldemo = "aglcore qt6-layer openembedded-layer networking-layer multimedia-layer flutter-layer meta-app-framework"

########### WORKAROUND FOR MESON and QT6 ############
QT6_INSTALL_LIBEXECDIR := "${bindir}"
```

## meta-agl/meta-agl-core/conf/distro/include/aarch64-tune.inc
```bitbake
# DEFAULTTUNE overrides for AGL on aarch64

# We should not need the tuning include below as the BSP should include the right set already.
# A double inclusion would produce a warning. This include line is just for reference
# include conf/machine/include/arm/arch-armv8.inc

AGL_DEFAULTTUNE ?= "aarch64"
DEFAULTTUNE:agldefaulttune = "${AGL_DEFAULTTUNE}"

# not yet ready
#QB_SYSTEM_NAME ?= "qemu-system-aarch"
#QB_DEFAULT_KERNEL ?= "zImage"
#QB_DEFAULT_FSTYPE ?= "ext4"
#QB_MACHINE ?= "-machine foo"
#QB_CPU ?= "-cpu bar"
```

## meta-agl/meta-agl-core/conf/distro/include/arm-tune.inc
```bitbake
# DEFAULTTUNE overrides for AGL on ARM 32bit

# We should not need the tuning include below as the BSP should include the right set already.
# A double inclusion would produce a warning. This include line is just for reference
#   include conf/machine/include/arm/arch-armv7ve.inc
# medium profile boards need to
#   include conf/machine/include/arch/arm-armv7-a.inc

# Standard target for 32bit ARM (newer than cortex-a15)
ARM_DEFAULTTUNE = "armv7vethf-neon-vfpv4"

# for cortex-a8, cortex-a9, cortex-a7 (=rpi 2/3)
ARM_DEFAULTTUNE := "${@bb.utils.contains('DISTRO_FEATURES', 'agl-medium-arm-compiler', 'armv7athf-neon', '${ARM_DEFAULTTUNE}', d)}"

# for armv6 (=rpi0/1)
ARM_DEFAULTTUNE := "${@bb.utils.contains('DISTRO_FEATURES', 'agl-low-arm-compiler', 'arm1176jzfshf', '${ARM_DEFAULTTUNE}', d)}"

AGL_DEFAULTTUNE ?= "${ARM_DEFAULTTUNE}"
DEFAULTTUNE:agldefaulttune := "${AGL_DEFAULTTUNE}"

QB_SYSTEM_NAME ?= "qemu-system-arm"
QB_DEFAULT_KERNEL ?= "zImage"
QB_DEFAULT_FSTYPE ?= "ext4"
QB_MACHINE ?= "${@bb.utils.contains('DISTRO_FEATURES', 'agl-medium-arm-compiler', '-machine vexpress-a9', '-machine vexpress-a15', d)}"
QB_CPU ?= "${@bb.utils.contains('DISTRO_FEATURES', 'agl-medium-arm-compiler', '-cpu cortex-a9', '-cpu cortex-a15', d)}"
```

## meta-agl/meta-agl-core/conf/distro/include/riscv64-tune.inc
```bitbake
# DEFAULTTUNE overrides for AGL on riscv64

# We should not need the tuning include below as the BSP should include the right set already.
# A double inclusion would produce a warning. This include line is just for reference
# include conf/machine/include/arm/arch-armv8.inc

AGL_DEFAULTTUNE ?= "riscv64"
DEFAULTTUNE:agldefaulttune = "${AGL_DEFAULTTUNE}"
```

## meta-agl/meta-agl-core/conf/distro/include/x86_64-tune.inc
```bitbake
# DEFAULTTUNE overrides for AGL on x86-64

# We should not need the tuning include below as the BSP should include the right set already.
# A double inclusion would produce a warning. This include line is just for reference
#include conf/machine/include/tune-corei7.inc
AGL_DEFAULTTUNE ?= "corei7-64"
DEFAULTTUNE:agldefaulttune = "${AGL_DEFAULTTUNE}"

# shortened copy of tune-corei7.inc due to bug in inclusion for tune-core2.inc
# TUNE_ARCH is using .= x86-64 , if done twice, you get x86-64x86-64 as TUNE_ARCH :/
# we should have at least the core2 tunings by default (=qemux86-64)

# Extra tune features
TUNEVALID[corei7] = "Enable corei7 specific processor optimizations"
TUNE_CCARGS = "${@bb.utils.contains('TUNE_FEATURES', 'corei7', ' -march=corei7 -mtune=corei7 -mfpmath=sse -msse4.2', '', d)}"

# Extra tune selections
AVAILTUNES += "corei7-32"
TUNE_FEATURES:tune-corei7-32 = "${TUNE_FEATURES:tune-x86} corei7"
BASE_LIB:tune-corei7-32 = "lib"
TUNE_PKGARCH:tune-corei7-32 = "corei7-32"
PACKAGE_EXTRA_ARCHS:tune-corei7-32 = "${PACKAGE_EXTRA_ARCHS:tune-core2-32} corei7-32"
QEMU_EXTRAOPTIONS_corei7-32 = " -cpu Nehalem,check=false"

AVAILTUNES += "corei7-64"
TUNE_FEATURES:tune-corei7-64 = "${TUNE_FEATURES:tune-x86-64} corei7"
BASE_LIB:tune-corei7-64 = "lib64"
TUNE_PKGARCH:tune-corei7-64 = "corei7-64"
PACKAGE_EXTRA_ARCHS:tune-corei7-64 = "${PACKAGE_EXTRA_ARCHS:tune-core2-64} corei7-64"
QEMU_EXTRAOPTIONS_corei7-64 = " -cpu Nehalem,check=false"

AVAILTUNES += "corei7-64-x32"
TUNE_FEATURES:tune-corei7-64-x32 = "${TUNE_FEATURES:tune-x86-64-x32} corei7"
BASE_LIB:tune-corei7-64-x32 = "libx32"
TUNE_PKGARCH:tune-corei7-64-x32 = "corei7-64-x32"
PACKAGE_EXTRA_ARCHS:tune-corei7-64-x32 = "${PACKAGE_EXTRA_ARCHS:tune-core2-64-x32} corei7-64-x32"
QEMU_EXTRAOPTIONS_corei7-64-x32 = " -cpu Nehalem,check=false"

TUNE_ARCH = "${@bb.utils.contains('TUNE_FEATURES', 'm64', '${X86ARCH64}', '' ,d)}"

# Bump qemux86-64 up to corei7
AVAILTUNES += "qemux86-64"
TUNE_FEATURES:tune-qemux86-64 = "${TUNE_FEATURES:tune-x86-64} corei7"
BASE_LIB:tune-qemux86-64 = "lib64"
TUNE_PKGARCH:tune-qemux86-64 = "corei7-64"
PACKAGE_EXTRA_ARCHS:tune-qemux86-64 = "${PACKAGE_EXTRA_ARCHS:tune-core2-64} corei7-64"
QEMU_EXTRAOPTIONS:qemux86-64 = " -cpu Nehalem,check=false"

# QEMU / runqemu options (partly overrides qemuboot-x86.inc)
QB_MACHINE = "-machine q35"
QB_SYSTEM_NAME:x86-64 = "qemu-system-x86_64"
QB_CPU:x86-64 = "-cpu qemu64,+ssse3,+sse4.1,+sse4.2,+popcnt"
QB_CPU_KVM:x86-64 = "-cpu kvm64 -cpu qemu64,+ssse3,+sse4.1,+sse4.2,+popcnt"

# Add the 'virtio-rng-pci' device otherwise the guest may run out of entropy
QB_OPT_APPEND = "-vga vmware -display default,show-cursor=on -usb -device usb-tablet -device virtio-rng-pci"
```

## meta-agl/meta-agl-core/conf/layer.conf
```bitbake
# We have a conf and classes directory, add to BBPATH
BBPATH =. "${LAYERDIR}:"

# We have recipes-* directories, add to BBFILES
BBFILES += "${LAYERDIR}/recipes-*/*/*.bb \
            ${LAYERDIR}/recipes-*/*/*.bbappend"

BBFILE_COLLECTIONS += "aglcore"
BBFILE_PATTERN_aglcore = "^${LAYERDIR}/"
BBFILE_PRIORITY_aglcore = "60"

BBFILES_DYNAMIC += " \
    openembedded-layer:${LAYERDIR}/dynamic-layers/meta-oe/*/*/*.bb \
    openembedded-layer:${LAYERDIR}/dynamic-layers/meta-oe/*/*/*.bbappend \
    \
    selinux:${LAYERDIR}/dynamic-layers/meta-selinux/*/*/*.bb \
    selinux:${LAYERDIR}/dynamic-layers/meta-selinux/*/*/*.bbappend \
    \
    qt6-layer:${LAYERDIR}/dynamic-layers/meta-qt6/*/*/*.bb \
    qt6-layer:${LAYERDIR}/dynamic-layers/meta-qt6/*/*/*.bbappend \
"

LAYERSERIES_COMPAT_aglcore = "wrynose"
LAYERDEPENDS_aglcore = "core"

# Sanity check for meta-virtualization layer.
# Setting SKIP_META_VIRT_SANITY_CHECK to "1" would skip the bbappend files check.
#INHERIT += "sanity-meta-agl-core"
```

## meta-agl/meta-agl-kuksa-val/conf/layer.conf
```bitbake
# We have a conf and classes directory, add to BBPATH
BBPATH .= ":${LAYERDIR}"

# We have recipes-* directories, add to BBFILES
BBFILES += "${LAYERDIR}/recipes-*/*/*.bb \
	${LAYERDIR}/recipes-*/*/*.bbappend"

BBFILE_COLLECTIONS += "meta-agl-kuksa-val"
BBFILE_PATTERN_meta-agl-kuksa-val = "^${LAYERDIR}/"
BBFILE_PRIORITY_meta-agl-kuksa-val = "60"

LAYERSERIES_COMPAT_meta-agl-kuksa-val = "wrynose"
LAYERDEPENDS_meta-agl-kuksa-val = "core aglcore openembedded-layer meta-python"
```

## meta-agl/meta-app-framework/conf/layer.conf
```bitbake
# We have a conf and classes directory, add to BBPATH
BBPATH .= ":${LAYERDIR}"

# We have recipes-* directories, add to BBFILES
BBFILES += "${LAYERDIR}/recipes-*/*/*.bb \
	${LAYERDIR}/recipes-*/*/*.bbappend"

BBFILE_COLLECTIONS += "meta-app-framework"
BBFILE_PATTERN_meta-app-framework = "^${LAYERDIR}/"
BBFILE_PRIORITY_meta-app-framework = "60"

LAYERSERIES_COMPAT_meta-app-framework = "wrynose"
LAYERDEPENDS_meta-app-framework = "core aglcore openembedded-layer"
```
