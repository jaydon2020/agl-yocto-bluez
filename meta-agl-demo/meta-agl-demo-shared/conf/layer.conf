## meta-agl-demo/meta-agl-demo-shared/conf/layer.conf
```bitbake
# We have a conf and classes directory, add to BBPATH
BBPATH =. "${LAYERDIR}:"

# We have recipes-* directories, add to BBFILES
BBFILES += "${LAYERDIR}/recipes-*/*/*.bb \
            ${LAYERDIR}/recipes-*/*/*.bbappend"

BBFILE_COLLECTIONS += "agldemo-shared"
BBFILE_PATTERN_agldemo-shared = "^${LAYERDIR}/"
BBFILE_PRIORITY_agldemo-shared = "71"

# Tentative for experimental slint support
BBFILES_DYNAMIC += " \
    meta-slint:${LAYERDIR}/dynamic-layers/meta-slint/*/*/*.bb \
    meta-slint:${LAYERDIR}/dynamic-layers/meta-slint/*/*/*.bbappend \
"

LICENSE_PATH += "${LAYERDIR}/licenses"

LAYERSERIES_COMPAT_agldemo-shared = "wrynose"

LAYERDEPENDS_agldemo-shared = "core qt6-layer"
```
